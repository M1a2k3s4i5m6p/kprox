#ifdef BOARD_M5STACK_CARDPUTER

#include "../globals.h"
#include "app_nostrprox.h"
#include "../credential_store.h"
#include "../nostr_client.h"

// FA6 solid 'comments' icon — 48x48 RGB565
// Path data from @fortawesome/free-solid-svg-icons (CC BY 4.0)
const uint16_t fa_comments_48[2304] PROGMEM = {
    0x5014,0x5014,0x5014,0x5014,0x5014,0x5014,0x5014,0x5014,0x5014,0x5014,0x5894,0x8AD8,
    0xBD1B,0xD63D,0xE6FE,0xF7BF,0xF7BF,0xE6FE,0xD63D,0xBCFB,0x8AB8,0x5894,0x5014,0x5014,
    0x5014,0x5014,0x5014,0x5014,0x5014,0x5014,0x5014,0x5014,0x5014,0x5014,0x5014,0x5014,
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    0x5014,0x5014,0x5014,0x5014,0x5014,0x5014,0x5014,0x5854,0xA3D9,0xF75E,0xEF5E,0x8277
};


namespace Cardputer {

static constexpr const char* CS_NOSTR_PRIVKEY = "__nostr__privkey";
static constexpr const char* CS_NOSTR_PUBKEY  = "__nostr__pubkey";
static constexpr const char* DEFAULT_RELAY    = "wss://relay.damus.io";
static constexpr const char* DEFAULT_CHANNEL  = "#kprox";

// ---- Credential store helpers -----------------------------------------------

bool AppNostrProx::_reloadKeys() {
    // Config always loads regardless of CredStore state
    preferences.begin("kprox_nostr", true);
    _relay   = preferences.getString("relay",   DEFAULT_RELAY);
    _channel = preferences.getString("channel", DEFAULT_CHANNEL);
    _name    = preferences.getString("name",    "");
    preferences.end();

    nostrClient.setLocalName(_name);

    if (credStoreLocked) { _keysLoaded = false; return false; }
    _privkey = credStoreGet(CS_NOSTR_PRIVKEY);
    _pubkey  = credStoreGet(CS_NOSTR_PUBKEY);
    _keysLoaded = (_privkey.length() == 64 && _pubkey.length() == 64);
    return _keysLoaded;
}

void AppNostrProx::_saveKeys() {
    credStoreSet(CS_NOSTR_PRIVKEY, _privkey);
    credStoreSet(CS_NOSTR_PUBKEY,  _pubkey);
}

void AppNostrProx::_saveConfig() {
    preferences.begin("kprox_nostr", false);
    preferences.putString("relay",   _relay);
    preferences.putString("channel", _channel);
    preferences.putString("name",    _name);
    preferences.end();
    nostrClient.setLocalName(_name);
}

// ---- Shared UI helpers ------------------------------------------------------

void AppNostrProx::_drawTopBar(int page, const char* extra) {
    auto& d = M5Cardputer.Display;
    uint16_t bc = d.color565(50, 20, 90);
    d.fillRect(0, 0, d.width(), BAR_H, bc);
    d.setTextSize(1);
    d.setTextColor(TFT_WHITE, bc);

    static const char* labels[NUM_PAGES] = {"Feed", "Status", "Config"};
    d.drawString(labels[page], 4, 3);
    drawTabHint(4 + d.textWidth(labels[page]) + 3);

    NostrState st = nostrClient.state();
    uint16_t sb = (st == NostrState::CONNECTED)                              ? d.color565(20, 100, 20)
                : (st == NostrState::CONNECTING || st == NostrState::HANDSHAKING) ? d.color565(100, 80, 0)
                :                                                               d.color565(80, 20, 20);
    const char* sl = (st == NostrState::CONNECTED)                              ? "CONN"
                   : (st == NostrState::CONNECTING || st == NostrState::HANDSHAKING) ? "..."
                   :                                                               "OFF";

    int bx = d.width() - 2;
    if (extra && *extra) {
        int ew = d.textWidth(extra) + 6;
        bx -= ew;
        d.fillRoundRect(bx, 2, ew, BAR_H-4, 2, d.color565(30,30,60));
        d.setTextColor(d.color565(180,160,255), d.color565(30,30,60));
        d.drawString(extra, bx + 3, 3);
    }
    int bw = d.textWidth(sl) + 8;
    bx -= bw;
    d.fillRoundRect(bx, 2, bw, BAR_H-4, 2, sb);
    d.setTextColor(TFT_WHITE, sb);
    d.drawString(sl, bx + 4, 3);
}

void AppNostrProx::_drawBottomBar(const char* hint) {
    auto& d = M5Cardputer.Display;
    uint16_t bc = d.color565(16, 16, 16);
    d.fillRect(0, d.height()-BOT_H, d.width(), BOT_H, bc);
    d.setTextSize(1);
    d.setTextColor(d.color565(110,110,110), bc);
    d.drawString(hint, 2, d.height()-BOT_H+2);
}

// ---- Page 0: Feed + Compose -------------------------------------------------
//
// Layout (135px tall display):
//   [0..15]    top bar      16px
//   [16..104]  feed area    89px  (~7 rows × 12px)
//   [105]      divider      1px
//   [106..120] input field  15px
//   [121..134] bottom bar   14px

static constexpr int FEED_Y      = AppNostrProx::BAR_H + 1;
static constexpr int INPUT_H     = 15;
static constexpr int INPUT_Y     = 135 - AppNostrProx::BOT_H - INPUT_H;
static constexpr int FEED_BOTTOM = INPUT_Y - 2;
static constexpr int FEED_ROW_H  = 12;

void AppNostrProx::_drawPage0() {
    auto& d = M5Cardputer.Display;
    d.fillScreen(NP_BG);
    char extra[6]; snprintf(extra, sizeof(extra), "%d", nostrClient.msgCount());
    _drawTopBar(0, extra);

    int feedRows = (FEED_BOTTOM - FEED_Y) / FEED_ROW_H;
    int total    = nostrClient.msgCount();

    // ---- Feed area ----
    if (total == 0) {
        d.setTextSize(1);
        d.setTextColor(d.color565(80, 80, 80), NP_BG);
        const char* msg;
        if (credStoreLocked)                 msg = "Unlock CredStore first";
        else if (!_keysLoaded)               msg = "No keys — go to Status (G)";
        else if (!nostrClient.isConnected()) msg = !_p0Status.isEmpty() ? _p0Status.c_str()
                                                                         : "Connecting...";
        else                                 msg = "Waiting for messages...";
        d.drawString(msg, 4, FEED_Y + 20);
    } else {
        int maxScroll = max(0, total - feedRows);
        if (_feedScrollPinned) _feedScroll = maxScroll;
        if (_feedScroll > maxScroll) _feedScroll = maxScroll;

        // _msgs[0]=oldest, display from _feedScroll (oldest at top, newest at bottom)
        int y = FEED_Y;
        for (int i = 0; i < feedRows && (_feedScroll + i) < total; i++) {
            const NostrMsg& m = nostrClient.msg(_feedScroll + i);
            d.setTextSize(1);
            char pfx[20]; snprintf(pfx, sizeof(pfx), "%s: ", m.name);
            int pfxW = d.textWidth(pfx);
            d.setTextColor(d.color565(140, 100, 200), NP_BG);
            d.drawString(pfx, 4, y);
            d.setTextColor(d.color565(210, 210, 210), NP_BG);
            int maxChars = (d.width() - pfxW - 8) / 6;
            String content = String(m.content);
            if ((int)content.length() > maxChars) content = content.substring(0, maxChars-1) + "~";
            d.drawString(content, 4 + pfxW, y);
            y += FEED_ROW_H;
        }

        if (total > feedRows) {
            char sb[10]; snprintf(sb, sizeof(sb), "%d/%d", _feedScroll + feedRows, total);
            d.setTextColor(d.color565(60,60,60), NP_BG);
            d.drawString(sb, d.width()-d.textWidth(sb)-2, FEED_Y);
        }
    }

    // ---- Divider ----
    d.drawFastHLine(0, INPUT_Y - 1, d.width(), d.color565(40, 20, 60));

    // ---- Input field ----
    bool canPost = nostrClient.isConnected() && _keysLoaded && !credStoreLocked;
    uint16_t ibg = _compEditing ? d.color565(25, 15, 50) : d.color565(16, 10, 32);
    d.fillRect(0, INPUT_Y, d.width(), INPUT_H, ibg);
    d.setTextSize(1);
    if (_compEditing) {
        int maxChars = (d.width() - 8) / 6;
        String disp = _compBuf;
        if ((int)disp.length() >= maxChars) disp = disp.substring(disp.length() - maxChars + 1);
        disp += '_';
        d.setTextColor(TFT_WHITE, ibg);
        d.drawString(disp, 4, INPUT_Y + 3);
    } else if (!_compStatus.isEmpty()) {
        d.setTextColor(_compStatusOk ? TFT_GREEN : d.color565(220,80,80), ibg);
        d.drawString(_compStatus, 4, INPUT_Y + 3);
    } else if (!nostrClient.lastRelayMsg().isEmpty()) {
        String rm = nostrClient.lastRelayMsg();
        if ((int)rm.length() > 34) rm = rm.substring(0, 33) + "~";
        uint16_t mc = rm.startsWith("REJECT") ? d.color565(220,80,80) : d.color565(140,140,100);
        d.setTextColor(mc, ibg);
        d.drawString(rm, 4, INPUT_Y + 3);
    } else {
        d.setTextColor(d.color565(60, 40, 80), ibg);
        d.drawString(canPost ? "ENTER to compose..." : (credStoreLocked ? "Unlock CredStore" : "Connect to post"), 4, INPUT_Y + 3);
    }

    if (_compEditing)
        _drawBottomBar("type  ENTER=send  ESC=cancel  DEL=del");
    else
        _drawBottomBar("ENTER=compose  up/dn=scroll  </>=page");
}

void AppNostrProx::_handlePage0(KeyInput ki) {
    int total    = nostrClient.msgCount();
    int feedRows = (FEED_BOTTOM - FEED_Y) / FEED_ROW_H;

    if (_compEditing) {
        if (ki.esc) { _compEditing = false; _compBuf = ""; _compStatus = ""; _needsRedraw = true; return; }
        if (ki.del && !_compBuf.isEmpty()) { _compBuf.remove(_compBuf.length()-1); _needsRedraw = true; return; }
        if (ki.enter) {
            if (_compBuf.isEmpty()) {
                _compEditing = false; _compStatus = ""; _needsRedraw = true; return;
            }
            _compStatus = "Signing..."; _compStatusOk = true;
            _needsRedraw = true; _drawPage0();
            if (nostrClient.publish(_privkey, _compBuf, _channel)) {
                _compStatus = "Sent!"; _compStatusOk = true;
                _compBuf = ""; _compEditing = false;
                _feedScrollPinned = true;   // auto-scroll to show own message at bottom
                _pendingRelayCheck = true;  // check relay OK/REJECT once, then stop
            } else {
                _compStatus = "Send failed"; _compStatusOk = false;
            }
            _needsRedraw = true; return;
        }
        if (ki.arrowUp) {
            if (_feedScroll > 0) { _feedScroll--; _feedScrollPinned = false; }
            _needsRedraw = true; return;
        }
        if (ki.arrowDown) {
            int maxScroll = max(0, total - feedRows);
            if (_feedScroll < maxScroll) _feedScroll++;
            if (_feedScroll >= maxScroll) _feedScrollPinned = true;
            _needsRedraw = true; return;
        }
        if (ki.ch && (int)_compBuf.length() < 280) { _compBuf += ki.ch; _compStatus = ""; _needsRedraw = true; }
        return;
    }

    if (ki.arrowLeft)  { _page = NUM_PAGES-1; _needsRedraw = true; return; }
    if (ki.arrowRight) { _page = 1;           _needsRedraw = true; return; }
    if (ki.arrowUp) {
        if (_feedScroll > 0) { _feedScroll--; _feedScrollPinned = false; }
        _needsRedraw = true; return;
    }
    if (ki.arrowDown) {
        int maxScroll = max(0, total - feedRows);
        if (_feedScroll < maxScroll) _feedScroll++;
        if (_feedScroll >= maxScroll) _feedScrollPinned = true;
        _needsRedraw = true; return;
    }

    if (ki.enter) {
        if (nostrClient.isConnected() && _keysLoaded && !credStoreLocked) {
            _compEditing = true; _compBuf = ""; _compStatus = ""; _needsRedraw = true;
        } else {
            _page = 1; _needsRedraw = true;
        }
    }
}

// ---- Page 1: Status / Connect / Keygen -------------------------------------

void AppNostrProx::_drawPage1() {
    auto& d = M5Cardputer.Display;
    d.fillScreen(NP_BG);
    _drawTopBar(1);
    int y = BAR_H + 4;
    d.setTextSize(1);

    if (credStoreLocked) {
        d.setTextColor(d.color565(220,140,60), NP_BG);
        d.drawString("CredStore locked.", 4, y); y += 14;
        d.setTextColor(d.color565(150,150,150), NP_BG);
        d.drawString("Unlock to use NostrProx.", 4, y);
        _drawBottomBar("</> page  ESC back");
        return;
    }

    // Pubkey row
    d.setTextColor(d.color565(140,140,140), NP_BG);
    d.drawString("Pubkey:", 4, y); y += 12;
    if (_keysLoaded) {
        d.setTextColor(d.color565(180,140,255), NP_BG);
        d.drawString(_pubkey.substring(0,32) + "..", 4, y);
    } else {
        d.setTextColor(d.color565(180,80,80), NP_BG);
        d.drawString("No keys — press G to generate", 4, y);
    }
    y += 14;

    // Relay row
    d.setTextColor(d.color565(140,140,140), NP_BG);
    d.drawString("Relay:", 4, y); y += 12;
    d.setTextColor(d.color565(100,200,255), NP_BG);
    String rd = _relay; if ((int)rd.length() > 34) rd = rd.substring(0,32) + "..";
    d.drawString(rd, 4, y); y += 14;

    // Channel row
    d.setTextColor(d.color565(140,140,140), NP_BG);
    d.drawString("Channel:", 4, y); y += 12;
    d.setTextColor(d.color565(100,200,120), NP_BG);
    d.drawString(_channel.isEmpty() ? "(none)" : _channel, 4, y); y += 14;

    // Status / error
    if (!_p0Status.isEmpty()) {
        d.setTextColor(_p0StatusOk ? TFT_GREEN : d.color565(220,80,80), NP_BG);
        d.drawString(_p0Status, 4, y); y += 12;
    }

    // Keygen confirm overlay
    if (_p0GenConfirm) {
        int ox=4, oy=d.height()-BOT_H-34;
        d.fillRoundRect(ox, oy, d.width()-8, 30, 4, d.color565(60,20,80));
        d.drawRoundRect(ox, oy, d.width()-8, 30, 4, d.color565(160,80,255));
        d.setTextColor(TFT_WHITE, d.color565(60,20,80));
        d.drawString("Overwrite existing keys? Y/N", ox+4, oy+4);
        d.setTextColor(d.color565(200,160,255), d.color565(60,20,80));
        d.drawString("This cannot be undone!", ox+4, oy+16);
        _drawBottomBar("Y=generate new keys  N=cancel");
        return;
    }

    const char* connLabel = nostrClient.isConnected() ? "ENTER=disconnect" : "ENTER=connect";
    char hint[64]; snprintf(hint, sizeof(hint), "%s  G=keygen  </>=page", connLabel);
    _drawBottomBar(hint);
}

void AppNostrProx::_handlePage1(KeyInput ki) {
    if (credStoreLocked) {
        if (ki.arrowLeft)  { _page = 0;           _needsRedraw = true; }
        if (ki.arrowRight) { _page = 2;            _needsRedraw = true; }
        return;
    }

    if (_p0GenConfirm) {
        if (ki.ch == 'y' || ki.ch == 'Y') {
            _p0GenConfirm = false;
            _p0Status = "Generating..."; _p0StatusOk = true;
            _needsRedraw = true; _drawPage1();
            String priv, pub;
            if (NostrClient::generateKeypair(priv, pub)) {
                _privkey = priv; _pubkey = pub; _keysLoaded = true;
                _saveKeys(); _p0Status = "Keys generated!"; _p0StatusOk = true;
            } else {
                _p0Status = "Key gen failed"; _p0StatusOk = false;
            }
        } else {
            _p0GenConfirm = false; _p0Status = "Cancelled"; _p0StatusOk = false;
        }
        _needsRedraw = true; return;
    }

    if (ki.arrowLeft)  { _page = 0;           _needsRedraw = true; return; }
    if (ki.arrowRight) { _page = 2;            _needsRedraw = true; return; }

    if (ki.ch == 'g' || ki.ch == 'G') {
        if (_keysLoaded) { _p0GenConfirm = true; }
        else {
            _p0Status = "Generating..."; _p0StatusOk = true;
            _needsRedraw = true; _drawPage1();
            String priv, pub;
            if (NostrClient::generateKeypair(priv, pub)) {
                _privkey = priv; _pubkey = pub; _keysLoaded = true;
                _saveKeys(); _p0Status = "Keys generated!"; _p0StatusOk = true;
            } else { _p0Status = "Key gen failed"; _p0StatusOk = false; }
        }
        _needsRedraw = true; return;
    }

    if (ki.enter) {
        if (nostrClient.isConnected()) {
            nostrClient.disconnect();
            _p0Status = "Disconnected"; _p0StatusOk = false;
        } else {
            _p0Status = "Connecting..."; _p0StatusOk = true;
            _needsRedraw = true; _drawPage1();
            if (WiFi.status() != WL_CONNECTED) {
                _p0Status = "No WiFi"; _p0StatusOk = false;
            } else if (nostrClient.connect(_relay)) {
                nostrClient.subscribe(_channel);
                _lastRefreshMs = millis();
                _p0Status = "Connected!"; _p0StatusOk = true;
                // Jump straight to feed
                _page = 0;
            } else {
                _p0Status = nostrClient.lastError(); _p0StatusOk = false;
            }
        }
        _needsRedraw = true; return;
    }
}

// ---- Page 2: Config ---------------------------------------------------------

void AppNostrProx::_drawPage2() {
    auto& d = M5Cardputer.Display;
    d.fillScreen(NP_BG);
    _drawTopBar(2);
    int y = BAR_H + 4;
    d.setTextSize(1);

    if (credStoreLocked) {
        d.setTextColor(d.color565(220,140,60), NP_BG);
        d.drawString("CredStore locked.", 4, y);
        _drawBottomBar("</> page  ESC back");
        return;
    }

    struct { const char* label; const String* val; CfgField field; } rows[CF_COUNT] = {
        { "Relay URL:", &_relay,   CF_RELAY   },
        { "Channel:",   &_channel, CF_CHANNEL },
        { "Name:",      &_name,    CF_NAME    },
    };

    for (int i = 0; i < CF_COUNT; i++) {
        bool sel  = (_cfgSel == (CfgField)i);
        bool edit = (sel && _cfgEditing);
        uint16_t rowBg = sel ? d.color565(30,10,60) : (uint16_t)NP_BG;
        if (sel) d.fillRect(0, y-1, d.width(), 26, rowBg);
        d.setTextColor(sel ? d.color565(200,160,255) : d.color565(140,140,140), rowBg);
        d.drawString(rows[i].label, 4, y); y += 10;
        uint16_t fbg = edit ? d.color565(40,20,80) : d.color565(20,15,40);
        d.fillRoundRect(4, y, d.width()-8, 13, 2, fbg);
        d.setTextColor(TFT_WHITE, fbg);
        String val = edit ? (_cfgBuf + "_") : *rows[i].val;
        if (val.isEmpty() && !edit) val = "(none)";
        if ((int)val.length() > 36) val = val.substring(val.length()-36);
        d.drawString(val, 6, y+2);
        y += 16;
    }

    if (!_cfgStatus.isEmpty()) {
        d.setTextColor(_cfgStatusOk ? TFT_GREEN : d.color565(220,80,80), NP_BG);
        d.drawString(_cfgStatus, 4, y);
    }

    if (_cfgEditing) _drawBottomBar("type  ENTER=save  ESC=cancel  DEL=del");
    else             _drawBottomBar("up/dn=row  ENTER=edit  </>=page  ESC");
}

void AppNostrProx::_handlePage2(KeyInput ki) {
    if (credStoreLocked) {
        if (ki.arrowLeft)  { _page = 1; _needsRedraw = true; }
        if (ki.arrowRight) { _page = 0; _needsRedraw = true; }
        return;
    }

    if (_cfgEditing) {
        if (ki.esc)   { _cfgEditing = false; _cfgBuf = ""; _cfgStatus = ""; _needsRedraw = true; return; }
        if (ki.del && !_cfgBuf.isEmpty()) { _cfgBuf.remove(_cfgBuf.length()-1); _needsRedraw = true; return; }
        if (ki.enter) {
            if (_cfgSel == CF_RELAY)   _relay   = _cfgBuf.isEmpty() ? String(DEFAULT_RELAY)   : _cfgBuf;
            if (_cfgSel == CF_CHANNEL) _channel = _cfgBuf.isEmpty() ? String(DEFAULT_CHANNEL) : _cfgBuf;
            if (_cfgSel == CF_NAME)    _name    = _cfgBuf;
            _saveConfig();
            _cfgEditing = false; _cfgBuf = "";
            _cfgStatus = "Saved"; _cfgStatusOk = true;
            if (nostrClient.isConnected()) {
                nostrClient.subscribe(_channel);
                _lastRefreshMs = millis();
            }
            _needsRedraw = true; return;
        }
        if (ki.ch && (int)_cfgBuf.length() < 100) { _cfgBuf += ki.ch; _cfgStatus = ""; _needsRedraw = true; }
        return;
    }

    if (ki.arrowLeft)  { _page = 1; _needsRedraw = true; return; }
    if (ki.arrowRight) { _page = 0; _needsRedraw = true; return; }
    if (ki.arrowUp || ki.arrowDown) {
        _cfgSel = (CfgField)(((int)_cfgSel + 1) % CF_COUNT);
        _cfgStatus = ""; _needsRedraw = true; return;
    }
    if (ki.enter) {
        if      (_cfgSel == CF_RELAY)   _cfgBuf = _relay;
        else if (_cfgSel == CF_CHANNEL) _cfgBuf = _channel;
        else if (_cfgSel == CF_NAME)    _cfgBuf = _name;
        _cfgEditing = true; _cfgStatus = ""; _needsRedraw = true;
    }
}

// ---- Lifecycle --------------------------------------------------------------

void AppNostrProx::onEnter() {
    _needsRedraw  = true;
    _p0Status     = "";
    _p0GenConfirm = false;
    _feedScroll       = 0;
    _feedScrollPinned = true;
    _compBuf      = "";
    _compEditing  = false;
    _compStatus   = "";
    _pendingRelayCheck = false;
    _cfgSel       = CF_RELAY;
    _cfgEditing   = false;
    _cfgBuf       = "";
    _cfgStatus    = "";
    _keysLoaded   = false;
    _reloadKeys();
    _lastPollMs    = 0;
    _lastRefreshMs = 0;
    _autoConnect   = false;

    // Always open on the feed
    _page = 0;

    // Queue auto-connect: fires on first onUpdate tick if conditions are met
    if (!nostrClient.isConnected() && !credStoreLocked &&
        WiFi.status() == WL_CONNECTED) {
        _autoConnect = true;
    }
}

void AppNostrProx::onExit() {
    // Disconnect cleanly — no relay traffic while app is closed
    nostrClient.disconnect();
    _compEditing  = false;
    _cfgEditing   = false;
    _p0GenConfirm = false;
}

void AppNostrProx::onUpdate() {
    unsigned long now = millis();

    if (M5Cardputer.BtnA.wasPressed()) {
        uiManager.notifyInteraction();
        _compEditing = false; _cfgEditing = false; _p0GenConfirm = false;
        _page = (_page + 1) % NUM_PAGES;
        _needsRedraw = true;
        return;
    }

    // Auto-connect on first tick after entering the app
    if (_autoConnect) {
        _autoConnect = false;
        _p0Status = "Connecting..."; _p0StatusOk = true;
        _needsRedraw = true;
        _drawPage0(); // show "connecting..." before blocking call
        if (nostrClient.connect(_relay)) {
            nostrClient.subscribe(_channel);
            _lastRefreshMs = millis();
            _p0Status = ""; // clear on success — feed speaks for itself
        } else {
            _p0Status = nostrClient.lastError();
            _p0StatusOk = false;
        }
        _needsRedraw = true;
    }

    // Poll for incoming frames every 50ms
    if (now - _lastPollMs >= 50) {
        _lastPollMs = now;
        bool got = nostrClient.poll();

        // One-shot relay OK/REJECT check after sending
        if (_pendingRelayCheck && !nostrClient.lastRelayMsg().isEmpty()) {
            const String& rm = nostrClient.lastRelayMsg();
            if (rm.startsWith("REJECT")) {
                _compStatus   = rm.length() > 28 ? rm.substring(0, 27) + "~" : rm;
                _compStatusOk = false;
                got = true;
            }
            _pendingRelayCheck = false;
        }

        if (got) _needsRedraw = true;
    }

    // Auto-refresh subscription every 60s while connected.
    if (nostrClient.isConnected() && _lastRefreshMs > 0 &&
        now - _lastRefreshMs >= 60000UL) {
        nostrClient.subscribe(_channel);
        _lastRefreshMs = now;
        _needsRedraw = true;
    }

    if (_needsRedraw) {
        switch (_page) {
            case 0: _drawPage0(); break;
            case 1: _drawPage1(); break;
            case 2: _drawPage2(); break;
        }
        _needsRedraw  = false;
        _lastRedrawMs = now;
    }

    bool editing = _compEditing || _cfgEditing;
    KeyInput ki  = pollKeys(editing);
    if (!ki.anyKey) return;
    uiManager.notifyInteraction();

    if (ki.esc && !editing && !_p0GenConfirm) {
        uiManager.returnToLauncher(); return;
    }

    switch (_page) {
        case 0: _handlePage0(ki); break;
        case 1: _handlePage1(ki); break;
        case 2: _handlePage2(ki); break;
    }
}

} // namespace Cardputer
#endif // BOARD_M5STACK_CARDPUTER
